#include "usb_host_display.h"

#include <esp_log.h>
#include <string.h>

static const char * TAG8 = "sc:usb_disp";

#ifdef ESP32_S3

#include <driver/gpio.h>
#include <driver/spi_master.h>
#include <esp_lcd_panel_io.h>
#include <esp_lcd_panel_ops.h>
#include <esp_lcd_panel_st7789.h>
#include <esp_lcd_panel_vendor.h>
#include <esp_system.h>
#include <freertos/FreeRTOS.h>
#include <freertos/semphr.h>
#include <freertos/task.h>
#include <stdlib.h>

// ESP32-S3-USB-OTG onboard 1.3" 240x240 ST7789 LCD (see arduino-esp32
// variants/esp32s3usbotg/pins_arduino.h for the authoritative pin map).
#define LCD_HOST      SPI2_HOST
#define PIN_LCD_DC    ((gpio_num_t)4)
#define PIN_LCD_CS    ((gpio_num_t)5)
#define PIN_LCD_SCLK  ((gpio_num_t)6)
#define PIN_LCD_MOSI  ((gpio_num_t)7)
#define PIN_LCD_RST   ((gpio_num_t)8)
#define PIN_LCD_BL    ((gpio_num_t)9)
#define LCD_H_RES     240
#define LCD_V_RES     240
#define LCD_PIXEL_CLOCK_HZ (20 * 1000 * 1000)

#define FONT_SCALE   2
#define GLYPH_W      (8 * FONT_SCALE)
#define CHAR_H       (8 * FONT_SCALE)
#define CHAR_GAP     1   // px between characters (13 columns; enough for a typical dotted-quad IP)
#define CHAR_W       (GLYPH_W + CHAR_GAP)
#define MARGIN_X     4   // px left/right margin, so the last column isn't flush against the bezel
#define TEXT_COLS    ((LCD_H_RES - 2 * MARGIN_X) / CHAR_W)

// 8x8 monochrome bitmap font, basic Latin (U+0000-U+007F). Public domain;
// see https://github.com/dhepper/font8x8 (itself derived from an old IBM VGA
// font by Marcel Sondaar). Bit 7 of each row byte is the leftmost pixel.
static const uint8_t font8x8_basic[128][8] = {
    { 0x00, 0x00, 0x00, 0x00, 0x00, 0x00, 0x00, 0x00},   // U+0000 (nul)
    { 0x00, 0x00, 0x00, 0x00, 0x00, 0x00, 0x00, 0x00},   // U+0001
    { 0x00, 0x00, 0x00, 0x00, 0x00, 0x00, 0x00, 0x00},   // U+0002
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    { 0x00, 0x00, 0x00, 0x00, 0x00, 0x00, 0x00, 0x00}    // U+007F
};

static esp_lcd_panel_handle_t g_panel = NULL;
static bool                   g_display_ready = false;

// One buffer per row, each reused only by set_line() calls targeting that row.
// esp_lcd_panel_draw_bitmap() queues an asynchronous SPI DMA transfer (the panel
// IO was created with trans_queue_depth=10) and can return before the transfer
// actually completes, so a single shared buffer could be overwritten by another
// row's draw while a previous transfer was still reading from it -- e.g. a hub
// and its downstream devices attaching within milliseconds of each other and
// each updating a different row. Separate per-row buffers avoid that entirely.
#define MAX_DISPLAY_ROWS 10  // rows 0-7: USB/CAT/VFO status; row 8: WiFi SSID; row 9: IP address
static uint16_t g_row_buf[MAX_DISPLAY_ROWS][LCD_H_RES * CHAR_H];
static SemaphoreHandle_t g_row_buf_mutex = NULL;

static void draw_char_into_row_buf (uint16_t * buf, int col, unsigned char c, uint16_t fg, uint16_t bg) {
    if (c >= 128)
        c = ' ';
    const uint8_t * glyph  = font8x8_basic[(int)c];
    int             x_base = MARGIN_X + col * CHAR_W;  // CHAR_W already includes CHAR_GAP

    for (int gy = 0; gy < 8; ++gy) {
        uint8_t row_bits = glyph[gy];
        for (int gx = 0; gx < 8; ++gx) {
            // Each glyph row byte has bit 0 as its leftmost pixel (verified empirically --
            // the previous 0x80>>gx assumption rendered every character mirrored).
            uint16_t color = (row_bits & (0x01 << gx)) ? fg : bg;
            for (int sy = 0; sy < FONT_SCALE; ++sy) {
                int y = gy * FONT_SCALE + sy;
                for (int sx = 0; sx < FONT_SCALE; ++sx) {
                    int x = x_base + gx * FONT_SCALE + sx;
                    if (x >= 0 && x < LCD_H_RES)
                        buf[y * LCD_H_RES + x] = color;
                }
            }
        }
    }
}

// Kept to <=12 chars (this display's TEXT_COLS) so nothing gets truncated.
static const char * reset_reason_str (esp_reset_reason_t reason) {
    switch (reason) {
    case ESP_RST_POWERON:   return "RST:POWERON";
    case ESP_RST_EXT:       return "RST:EXT";
    case ESP_RST_SW:        return "RST:SW";
    case ESP_RST_PANIC:     return "RST:PANIC";
    case ESP_RST_INT_WDT:   return "RST:INT_WDT";
    case ESP_RST_TASK_WDT:  return "RST:TASK_WDT";
    case ESP_RST_WDT:       return "RST:WDT";
    case ESP_RST_DEEPSLEEP: return "RST:DEEPSLP";
    case ESP_RST_BROWNOUT:  return "RST:BROWNOUT";
    case ESP_RST_SDIO:      return "RST:SDIO";
    case ESP_RST_USB:       return "RST:USB";
    case ESP_RST_JTAG:      return "RST:JTAG";
    default:                return "RST:UNKNOWN";
    }
}

#endif  // ESP32_S3

void usb_host_display_init (void) {
    #ifdef ESP32_S3
        g_row_buf_mutex = xSemaphoreCreateMutex ();

        gpio_set_direction (PIN_LCD_BL, GPIO_MODE_OUTPUT);
        gpio_set_level (PIN_LCD_BL, 0);  // backlight off until the panel is actually initialized

        spi_bus_config_t buscfg = {};
        buscfg.sclk_io_num     = PIN_LCD_SCLK;
        buscfg.mosi_io_num     = PIN_LCD_MOSI;
        buscfg.miso_io_num     = -1;
        buscfg.quadwp_io_num   = -1;
        buscfg.quadhd_io_num   = -1;
        buscfg.max_transfer_sz = LCD_H_RES * CHAR_H * sizeof (uint16_t);

        if (spi_bus_initialize (LCD_HOST, &buscfg, SPI_DMA_CH_AUTO) != ESP_OK) {
            ESP_LOGE (TAG8, "spi_bus_initialize() failed");
            return;
        }

        esp_lcd_panel_io_handle_t   io_handle = NULL;
        esp_lcd_panel_io_spi_config_t io_config = {};
        io_config.dc_gpio_num      = PIN_LCD_DC;
        io_config.cs_gpio_num      = PIN_LCD_CS;
        io_config.pclk_hz          = LCD_PIXEL_CLOCK_HZ;
        io_config.lcd_cmd_bits     = 8;
        io_config.lcd_param_bits   = 8;
        io_config.spi_mode         = 0;
        io_config.trans_queue_depth = 10;

        if (esp_lcd_new_panel_io_spi ((esp_lcd_spi_bus_handle_t)LCD_HOST, &io_config, &io_handle) != ESP_OK) {
            ESP_LOGE (TAG8, "esp_lcd_new_panel_io_spi() failed");
            return;
        }

        esp_lcd_panel_dev_config_t panel_config = {};
        panel_config.reset_gpio_num = PIN_LCD_RST;
        panel_config.rgb_ele_order  = LCD_RGB_ELEMENT_ORDER_BGR;
        panel_config.bits_per_pixel = 16;

        if (esp_lcd_new_panel_st7789 (io_handle, &panel_config, &g_panel) != ESP_OK) {
            ESP_LOGE (TAG8, "esp_lcd_new_panel_st7789() failed");
            return;
        }

        esp_lcd_panel_reset (g_panel);
        esp_lcd_panel_init (g_panel);
        esp_lcd_panel_mirror (g_panel, false, false);  // text was mirrored left/right with (true, false)
        // This panel appears to need inverted color data -- without this, black/white are
        // swapped (a black background renders as white, so only "black" text was visible).
        esp_lcd_panel_invert_color (g_panel, true);
        esp_lcd_panel_disp_on_off (g_panel, true);
        gpio_set_level (PIN_LCD_BL, 1);  // backlight on

        g_display_ready = true;

        // Clear to black (content is all-zero, so any row buffer works for this).
        for (int i = 0; i < LCD_H_RES * CHAR_H; ++i)
            g_row_buf[0][i] = 0x0000;
        for (int y = 0; y < LCD_V_RES; y += CHAR_H)
            esp_lcd_panel_draw_bitmap (g_panel, 0, y, LCD_H_RES, y + CHAR_H, g_row_buf[0]);

        usb_host_display_set_line (0, "USB HOST", DISPLAY_COLOR_WHITE);
        // Shown once at boot so an unexpected reset (e.g. a brownout from a WiFi TX current
        // spike) is visible on-screen without needing console access to run `esp_reset_reason`.
        usb_host_display_set_line (7, reset_reason_str (esp_reset_reason()), DISPLAY_COLOR_YELLOW);
        ESP_LOGI (TAG8, "USB host status display initialized");
    #endif
}

void usb_host_display_set_line (int row, const char * text, uint16_t color) {
    #ifdef ESP32_S3
        (void)color;  // callers still pass a semantic color, but a single flat color
                       // reads more easily on this small panel, so it's ignored here.
        if (!g_display_ready || row < 0 || row >= MAX_DISPLAY_ROWS || row * CHAR_H + CHAR_H > LCD_V_RES)
            return;

        xSemaphoreTake (g_row_buf_mutex, portMAX_DELAY);

        uint16_t * buf = g_row_buf[row];
        for (int i = 0; i < LCD_H_RES * CHAR_H; ++i)
            buf[i] = 0x0000;

        size_t len = text ? strlen (text) : 0;
        if (len > (size_t)TEXT_COLS)
            len = TEXT_COLS;
        for (size_t col = 0; col < len; ++col)
            draw_char_into_row_buf (buf, (int)col, text[col], DISPLAY_COLOR_WHITE, 0x0000);

        int y = row * CHAR_H;
        esp_lcd_panel_draw_bitmap (g_panel, 0, y, LCD_H_RES, y + CHAR_H, buf);

        xSemaphoreGive (g_row_buf_mutex);
    #else
        (void)row;
        (void)text;
        (void)color;
    #endif
}
